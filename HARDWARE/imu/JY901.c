#include <string.h>
#include "JY901.h"
#include "stdio.h"
#include "rs485.h"
#include "led.h"

/**********************************************************************************************
jy901 modbus 协议解析
包含文件：jy901.h,jy901.c
移植①：修改模块波特率和程序485波特率，使之相等
		②：完善RS485_Send_Data函数实体，参数为要发送的字节
		③：在串口中断调用CopeSerialData，参数位收到的字节
		④：根据你的modbus节点数量填写imuNum的宏定义
		⑤：根据你节点填写allowAddeId数组内容，毋须按照顺序，填进去即可
		⑥：解析后的调用，使用stcIMU[]结构体数组调用相应数据
		
日期：	2019年1月23日
作者：	meetwit
***********************************************************************************************/

struct STime		stcTime={0};
struct SAcc 		stcAcc={0};
struct SGyro 		stcGyro={0};
struct SAngle 		stcAngle={0};
struct SMag 		stcMag={0};
struct SDStatus 	stcDStatus={0};
struct SPress 		stcPress={0};
struct SLonLat 		stcLonLat={0};
struct SGPSV 		stcGPSV={0};

struct IMU			stcIMU[imuNum]={0};												//对外调用该结构体即可

unsigned char allowAddeId[imuNum]={0x50,0x51,0x52};				//系统中modbus节点地址

unsigned char auchCRCHi[256] ={
	0x00, 0xC1, 0x81, 0x40, 0x01, 0xC0, 0x80, 0x41, 0x01, 0xC0, 0x80, 0x41, 0x00, 0xC1, 0x81,
	0x40, 0x01, 0xC0, 0x80, 0x41, 0x00, 0xC1, 0x81, 0x40, 0x00, 0xC1, 0x81, 0x40, 0x01, 0xC0,
	0x80, 0x41, 0x01, 0xC0, 0x80, 0x41, 0x00, 0xC1, 0x81, 0x40, 0x00, 0xC1, 0x81, 0x40, 0x01,
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	0x00, 0xC1, 0x81, 0x40, 0x01, 0xC0, 0x80, 0x41, 0x01, 0xC0, 0x80, 0x41, 0x00, 0xC1, 0x81,
	0x40} ;
unsigned char auchCRCLo[256] ={
	0x00, 0xC0, 0xC1, 0x01, 0xC3, 0x03, 0x02, 0xC2, 0xC6, 0x06, 0x07, 0xC7, 0x05, 0xC5, 0xC4,
	0x04, 0xCC, 0x0C, 0x0D, 0xCD, 0x0F, 0xCF, 0xCE, 0x0E, 0x0A, 0xCA, 0xCB, 0x0B, 0xC9, 0x09,
	0x08, 0xC8, 0xD8, 0x18, 0x19, 0xD9, 0x1B, 0xDB, 0xDA, 0x1A, 0x1E, 0xDE, 0xDF, 0x1F, 0xDD, 
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	0x44, 0x84, 0x85, 0x45, 0x87, 0x47, 0x46, 0x86, 0x82, 0x42, 0x43, 0x83, 0x41, 0x81, 0x80, 
	0x40 };
	
	//加入以下代码,支持printf函数,而不需要选择use MicroLIB	  
#if 1
#pragma import(__use_no_semihosting)             
//标准库需要的支持函数                 
struct __FILE 
{ 
	int handle; 
	/* Whatever you require here. If the only file you are using is */ 
	/* standard output using printf() for debugging, no file handling */ 
	/* is required. */ 
}; 
/* FILE is typedef’ d in stdio.h. */ 
FILE __stdout;       
//定义_sys_exit()以避免使用半主机模式    
void _sys_exit(int x) 
{ 
	x = x; 
} 
//重定义fputc函数 
int fputc(int ch, FILE *f)
{      
	while((USART1->SR&0X40)==0);//循环发送,直到发送完毕   
	USART1->DR = (u8) ch;      
	return ch;
}
#endif 

unsigned short CRC16(unsigned char *puchMsg,unsigned short usDataLen) //CRC校验
		{ 
				char uchCRCHi = 0xFF ; /* ? CRC 高位 */
				char uchCRCLo = 0xFF ; /* ? CRC低位*/
				int uIndex ; /* CRC 索引 */
				int i = 0;
				for (;i<usDataLen;i++)
				{
						uIndex = (int)(uchCRCHi ^ puchMsg[i]) ; /* ?? CRC */
						uchCRCHi = (char)(uchCRCLo ^ auchCRCHi[uIndex]) ;
						uchCRCLo = auchCRCLo[uIndex] ;
				}
				return (unsigned short)(((short)uchCRCHi << 8) | (short)uchCRCLo) ;
		}

/*
函数名：	send485
传	参：	data
返回值：	void
		作	用：	485发送实体函数
日	期：	2019年1月22日
作	者：	meetwit		
*/		
void send485(unsigned char data){
		RS485_Send_Data(&data,sizeof(unsigned char));	
}


/*
函数名：	CopeSerialData
传	参：	ucData 串口收到的字节
返回值：	void
作	用：	解析jy901接收到的数据
日	期：	2019年1月22日
作	者：	meetwit
*/
void CopeSerialData(unsigned char ucData)
{
	static unsigned char ucRxBuffer[11];
	static unsigned char ucRxCnt = 0;	
	static unsigned char ucRxLen = 0;	
	static float temp1 = 208.98;
	static float temp2 = 16.384;
	static float temp3 = 182.04;
	static unsigned char  index = 0,curId[imuNum];
	
	
	ucRxBuffer[ucRxCnt++]=ucData;
	if(ucRxCnt==1){
		return;
	}
	if(ucRxCnt==2){
		if (ucRxBuffer[1]!=0x03)
		{
			ucRxCnt=0;																															  
		}
			return;		
	}
	if(ucRxCnt==3){
			ucRxLen = ucRxBuffer[2]+5;
			return;		
	}
	if (ucRxCnt<ucRxLen) {
		return;
		}
	else
	{
			for(index=0;index<imuNum;index++){
				if(stcIMU[index].addrId==ucRxBuffer[0]){
					break;
				}
			}
		if(stcIMU[index].addrReg==Roll){				//角度
			stcAngle.Angle[0] = ((unsigned short)ucRxBuffer[3]<<8)|ucRxBuffer[4];
			stcAngle.Angle[1] = ((unsigned short)ucRxBuffer[5]<<8)|ucRxBuffer[6];
			stcAngle.Angle[2] = ((unsigned short)ucRxBuffer[7]<<8)|ucRxBuffer[8];
			stcIMU[index].x_Angle = stcAngle.Angle[0]/temp3;		//单位：°
			stcIMU[index].y_Angle = stcAngle.Angle[1]/temp3;
			stcIMU[index].z_Angle = stcAngle.Angle[2]/temp3;
	if(stcIMU[index].x_Angle>110&&curId[index]){
		//printf("%d",stcIMU[index].addrId);
		while((USART1->SR&0X40)==0);//循环发送,直到发送完毕   
		USART1->DR =  stcIMU[index].addrId;  
		curId[index] = 0;
		if(index==1) LED0=0;
		if(index==2) LED1=0;
	}else if(stcIMU[index].x_Angle<=110){
		curId[index] = 1;
		if(index==1) LED0=1;
		if(index==2) LED1=1;
	}
			
	
			
//printf("%d,%d,%d,%d,%7.2f,%7.2f,%7.2f\r\n",Roll,ucRxBuffer[0],stcIMU[index].addrId,ucRxCnt,stcIMU[index].x_Angle,stcIMU[index].y_Angle,stcIMU[index].z_Angle);
		}else if(stcIMU[index].addrReg==AX){		//加速度
			stcAcc.a[0] = ((unsigned short)ucRxBuffer[3]<<8)|ucRxBuffer[4];
			stcAcc.a[1] = ((unsigned short)ucRxBuffer[5]<<8)|ucRxBuffer[6];
			stcAcc.a[2] = ((unsigned short)ucRxBuffer[7]<<8)|ucRxBuffer[8];
			stcIMU[index].x_a = stcAcc.a[0]/temp1;			//单位：m/s^2
			stcIMU[index].y_a = stcAcc.a[1]/temp1;
			stcIMU[index].z_a = stcAcc.a[2]/temp1;
//printf("%d,%d,%d,%d,%7.2f,%7.2f,%7.2f\r\n",AX,ucRxBuffer[0],stcIMU[index].addrId,ucRxCnt,stcIMU[index].x_a,stcIMU[index].y_a,stcIMU[index].z_a);
		}else if(stcIMU[index].addrReg==GX){		//角速度
			stcGyro.w[0] = ((unsigned short)ucRxBuffer[3]<<8)|ucRxBuffer[4];
			stcGyro.w[1] = ((unsigned short)ucRxBuffer[5]<<8)|ucRxBuffer[6];
			stcGyro.w[2] = ((unsigned short)ucRxBuffer[7]<<8)|ucRxBuffer[8];
			stcIMU[index].x_w = stcGyro.w[0]/temp2;		//单位：°/s
			stcIMU[index].y_w = stcGyro.w[1]/temp2;
			stcIMU[index].z_w = stcGyro.w[2]/temp2;
//printf("%d,%d,%d,%d,%7.2f,%7.2f,%7.2f\r\n",GX,ucRxBuffer[0],stcIMU[index].addrId,ucRxCnt,stcIMU[index].x_w,stcIMU[index].y_w,stcIMU[index].z_w);
		}
		ucRxCnt=0;
	}
}

/*
函数名：	ModbusRWReg
参	数：	Addr					：从机地址		
					R_W						：==0x03/0x06		读命令/写命令
					usReg					：读/写	寄存器地址			
					usRegNumDate	：写的内容/读的个数
返回值：	void
作	用：	modbus读写的协议
时	间：	2019年1月22日
作	者：	meetwit
*/
void 	ModbusRWReg(unsigned short Addr, unsigned short R_W, unsigned short usReg, unsigned short usRegNumDate){
			char i=0,j=0;
      char cIndex=0;
	    unsigned char record[8];
	    short checkCRC;
			for(j=0;j<imuNum;j++){
				if(allowAddeId[j]==Addr){
					stcIMU[j].addrId = Addr;
					stcIMU[j].addrReg = usReg;
					break;
				}
			}
	    record[cIndex++]=Addr;
	    record[cIndex++]=R_W;
	    record[cIndex++]=usReg<<8;
	    record[cIndex++]=usReg&0xff;
	    record[cIndex++]=usRegNumDate<<8;
	    record[cIndex++]=usRegNumDate&0xff;
	    checkCRC=CRC16(record,cIndex);
	    record[cIndex++]=checkCRC&0xff; 
	    record[cIndex++]=(checkCRC>>8)&0xff;
		  for(i=0;i<=cIndex;i++)
			send485(record[i]);
}
